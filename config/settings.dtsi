&lt {
  flavor = "balanced";
  tapping-term-ms = <200>;

  // Quickly tap-tap-holding the lt button will repeat the tap behavior
  // For example enter-enter-hold, will output multiple enter while you
  // keep holding the key.
  // But holding enter without double tapping, will activate the layer.
  quick-tap-ms = <200>;
};

&caps_word {
  continue-list = <
    UNDERSCORE MINUS
    LCTRL LALT LGUI LSHFT
    RCTRL RALT RGUI RSHFT
    BACKSPACE
  >;
};
